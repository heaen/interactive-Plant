#include <Arduino.h>
#include <SoftwareSerial.h>
#include <DFRobotDFPlayerMini.h>

SoftwareSerial mySoftwareSerial(10,11); // RX, TX
DFRobotDFPlayerMini myDFPlayer;
void printDetail(uint8_t type, int value);

int const trigPin = 6;
int const echoPin = 5;
void setup()
{
  
mySoftwareSerial.begin(9600);
  Serial.begin(115200);

  if (!myDFPlayer.begin(mySoftwareSerial)) {  
  //Use softwareSerial to communicate with mp3.
  }

myDFPlayer.volume(0);
myDFPlayer.loop(1);
delay(1000);

pinMode(trigPin, OUTPUT); 
pinMode(echoPin, INPUT); 
}

void loop() {
  
int duration, distance;
digitalWrite(trigPin, HIGH);
delay(1);
digitalWrite(trigPin, LOW);
duration = pulseIn(echoPin, HIGH);
distance = (duration/2) / 29.1;


if (distance <= 4000 && distance >= 2000) {
// play loud
myDFPlayer.volume(0);
} 
if (distance <= 50 && distance >= 0) {
// play loud
myDFPlayer.volume(0);
} 
if (distance <= 100 && distance >= 50) {
// play middle
myDFPlayer.volume(10);
}
if (distance <= 200 && distance >= 100) {
// play loud
myDFPlayer.volume(20);
}
if (distance <= 400 && distance >= 200) {
// play loud
myDFPlayer.volume(30); 
} 
if (distance <= 800 && distance >= 400) {
// play loud
myDFPlayer.volume(30); 
} 

else {
// Don't play
myDFPlayer.volume(0);

static unsigned long timer = millis();
}

delay(60);
}
