#include <CapacitiveSensor.h>
#include <Arduino.h>
#include <SoftwareSerial.h>
#include <DFRobotDFPlayerMini.h>

SoftwareSerial mySoftwareSerial(10,11); // RX, TX
DFRobotDFPlayerMini myDFPlayer;
void printDetail(uint8_t type, int value);

// 1 megohm resistor between pins 4 & 2
CapacitiveSensor touchSwitch = CapacitiveSensor(4, 2);

int LEDpin = 7;

void setup()
{
 pinMode(LEDpin, OUTPUT);
 Serial.begin(9600);
 
 mySoftwareSerial.begin(9600);
  Serial.begin(115200);

  if (!myDFPlayer.begin(mySoftwareSerial)) {  
  //Use softwareSerial to communicate with mp3.
  }

  myDFPlayer.volume(0);  //volume 0 - 30
  myDFPlayer.loop(1);
  delay(1000);
}

void loop()
{ int touch;
  
  static unsigned long timer = millis();
  
 long val = touchSwitch.capacitiveSensor(50);
 val = constrain(val, 150, 1000);
 val = map(val, 150, 1000, 0, 255);
 
if (val <= 25 && val >= 0.5) {
myDFPlayer.volume(5);  
}

if (val <= 50 && val >= 25) {
myDFPlayer.volume(10);  
}

if (val <= 250 && val >= 50) {
myDFPlayer.volume(20);  
}

else {
myDFPlayer.volume(0);
}

 analogWrite(LEDpin, val);
 Serial.println(val);
}
